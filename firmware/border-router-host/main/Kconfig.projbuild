## firmware/border-router-host/main/Kconfig.projbuild
```kconfig
menu "ESP Thread Border Router"

config LED_STATUS_ENABLE
    bool "Enable WS2812 RGB status LED (disabled=red blink, detached=blue blink, leader=green solid, router=purple solid, child=blue solid)"
    default y
    help
        WS2812/WS2812B addressable RGB LED on ESP32-S3.
        ESP32-S3 DevKitC-1: GPIO 48 (onboard LED) or GPIO 5 (external LED).

config LED_STATUS_GPIO
    int "GPIO for the RGB LED data line (WS2812)"
    depends on LED_STATUS_ENABLE
    default 48
    range 0 48
    help
        GPIO pin for the WS2812/WS2812B LED data line.
        ESP32-S3 DevKitC-1: GPIO 48 for the onboard LED, GPIO 5 for an external LED.

config BR_ETH_W5500_ENABLE
    bool "Enable Ethernet W5500 (preferred backhaul, SPI)"
    default y
    select ETH_USE_SPI_ETHERNET
    select ETH_SPI_ETHERNET_W5500
    help
        BR uses W5500 over SPI as backhaul (LAN only, no Wi-Fi). ESP32-S3 has no EMAC.

if BR_ETH_W5500_ENABLE
    config BR_ETH_SPI_HOST
        int "SPI host for W5500"
        range 0 2
        default 2
        help
            SPI2 is usually used to avoid UART RCP conflict (SPI1 can be used for flash).

    config BR_ETH_SPI_SCLK_GPIO
        int "W5500 SCLK GPIO"
        default 12
        help
            ESP32-S3: 12 is recommended for SPI2.

    config BR_ETH_SPI_MOSI_GPIO
        int "W5500 MOSI GPIO"
        default 11

    config BR_ETH_SPI_MISO_GPIO
        int "W5500 MISO GPIO"
        default 13

    config BR_ETH_SPI_CS_GPIO
        int "W5500 CS GPIO"
        default 10

    config BR_ETH_SPI_CLOCK_MHZ
        int "SPI clock (MHz)"
        range 5 40
        default 20

    config BR_ETH_INT_GPIO
        int "W5500 INT GPIO (-1 = polling)"
        range -1 48
        default 9
        help
            W5500 interrupt pin. -1 = use polling. Default 9 (avoid SPI/CS and RCP conflict).

    config BR_ETH_RST_GPIO
        int "W5500 RST (reset) GPIO (-1 = unused)"
        range -1 48
        default 6
        help
            W5500 reset pin. -1 = RST not wired (power-on reset). Default 6 (avoid RCP 7/8 conflict).

    config BR_ETH_RST_HOLD_MS
        int "W5500 RST hold time (ms)"
        default 200
        range 10 2000
        help
            RST hold time at low level before releasing. Increase if link/init is unstable.

    config BR_ETH_RST_RELEASE_MS
        int "W5500 RST release delay (ms)"
        default 1000
        range 10 1000
        help
            Delay after releasing RST before initializing SPI/driver.

    config BR_ETH_POLLING_MS
        int "W5500 polling period (ms, when INT=-1)"
        default 20
        help
            Poll period when not using interrupt; ignored when using INT.

    config BR_ETH_LINK_TIMEOUT_MS
        int "IPv4 (DHCP) wait timeout on Ethernet (ms)"
        default 25000
        help
            Wait for IPv4 (DHCP). Backend needs IPv4 to connect to the BR. IPv6 link-local is usually up earlier but not enough; init only succeeds when DHCP is up. Use >= 20s for slow routers.
endif

config BR_FRAME_TCP_PORT
    int "TCP port for the frame channel (BR listen)"
    default 5150
    range 1 65535
    help
        BR listens on this port; dashboard connects to BR_IP:port to send/receive frames.

#
# RCP: BR <-> RCP communication only via SPI. UART reserved for RCP flash/update later.
#
config BR_RCP_SPI_HOST
    int "RCP SPI host (1=SPI2, 2=SPI3)"
    range 1 2
    default 1
    help
        Usually use SPI1 (1) if W5500 uses SPI2 to avoid conflict.

config BR_RCP_SPI_SCLK_GPIO
    int "RCP SPI SCLK GPIO"
    default 4
    help
        Must not overlap W5500 (10,11,12,13) or RCP RST/BOOT (7,8).

config BR_RCP_SPI_MOSI_GPIO
    int "RCP SPI MOSI GPIO"
    default 5

config BR_RCP_SPI_MISO_GPIO
    int "RCP SPI MISO GPIO"
    default 2

config BR_RCP_SPI_CS_GPIO
    int "RCP SPI CS GPIO"
    default 3
    help
        Must not overlap W5500 CS (10).

config BR_RCP_SPI_IRQ_GPIO
    int "RCP SPI IRQ (intr) GPIO (-1 = poll)"
    range -1 48
    default 1
    help
        Interrupt pin from RCP. Must not overlap W5500 INT (9). Wired from H2 GPIO4 (RCP IRQ).

config BR_RCP_SPI_CLOCK_MHZ
    int "RCP SPI clock (MHz)"
    range 1 40
    default 10

#
# RCP control pins (RESET/BOOT) — shared for UART and SPI
#
config BR_RCP_RESET_GPIO
    int "RCP RESET GPIO"
    default 7
    help
        Host GPIO wired to the RCP RESET pin (ESP32-H2).

config BR_RCP_BOOT_GPIO
    int "RCP BOOT GPIO"
    default 8
    help
        Host GPIO wired to the RCP BOOT pin (download mode).

endmenu
```

## firmware/rcp/main/Kconfig.projbuild
```kconfig
# rcp: giao tiếp Host (br-host) chỉ qua SPI.
# UART dành sau cho flash/update RCP, không dùng cho BR ↔ RCP.

menu "RCP SPI (Host connection)"

config RCP_SPI_MOSI_GPIO
    int "SPI MOSI GPIO (Host → RCP)"
    default 3
    help
        Trên RCP: nhận data từ Host. Khớp với chân MOSI trên Host (Host MOSI nối RCP MOSI).

config RCP_SPI_MISO_GPIO
    int "SPI MISO GPIO (RCP → Host)"
    default 1
    help
        Trên RCP: gửi data tới Host. Khớp với chân MISO trên Host.

config RCP_SPI_SCLK_GPIO
    int "SPI SCLK GPIO"
    default 0

config RCP_SPI_CS_GPIO
    int "SPI CS GPIO"
    default 2
    help
        Chip select từ Host.

config RCP_SPI_IRQ_GPIO
    int "SPI IRQ GPIO (RCP báo 'data ready' cho Host, -1 = không dùng)"
    range -1 48
    default 4
    help
        Trên H2: kéo chân này khi có frame gửi Host. Không dùng GPIO9 (BOOT strapping).
        Nối chân này tới BR_RCP_SPI_IRQ_GPIO trên S3. SPI đã dùng 0,1,2,3 nên mặc định 4.

endmenu
```
